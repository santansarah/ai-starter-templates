## CMakeLists.txt
```
cmake_minimum_required(VERSION 3.20.0)
find_package(Zephyr REQUIRED HINTS $ENV{ZEPHYR_BASE})
project(ble_hardware_template)
target_sources(app PRIVATE
  src/main.c src/ble/advertising.c src/ble/service.c
  src/protocol/codec.c src/application/device.c
  src/acquisition/state.c src/acquisition/service.c
  src/hardware/simulated.c src/hardware/stub.c)
```

## Kconfig
```
mainmenu "Generic BLE hardware blueprint"
source "Kconfig.zephyr"
config TEMPLATE_ACQUISITION_INTERVAL_MS
	int "Delay between acquisition attempts (ms)"
	range 10 60000
	default 500
config TEMPLATE_PUBLICATION_INTERVAL_MS
	int "Delay between BLE publication attempts (ms)"
	range 10 60000
	default 500
config TEMPLATE_STALE_MS
	int "Age at which a successful sample becomes stale (ms)"
	range 1 600000
	default 1500
```

## prj.conf
```kconfig
CONFIG_SERIAL=y
CONFIG_CONSOLE=y
CONFIG_UART_CONSOLE=y
CONFIG_PRINTK=y
CONFIG_BT=y
CONFIG_BT_PERIPHERAL=y
CONFIG_BT_MAX_CONN=1
```

## src/main.c
```c
#include <zephyr/sys/printk.h>
#include "acquisition/service.h"
#include "hardware/simulated.h"
#include "ble/advertising.h"
#include "ble/service.h"
int main(void)
{
	int err = acquisition_start(&simulated_hardware);
	if (!err) { err = ble_start(); }
	if (err) {
		printk("Template startup failed: %d\n", err);
		return err;
	}
	ble_publication_start();
	printk("BLE template ready: SYNTHETIC data only\n");
	return 0;
}
```
